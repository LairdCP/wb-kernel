/*
 * at91-dvk_som60sd_mfg.dts - Device Tree file for the Manufacturing SOM60 board
 *
 *  Copyright (C) 2018 Laird,
 *		  2018 Ben Whitten <ben.whitten@lairdconnect.com>
 *		  2018 Boris Krasnovskiy <boris.krasnovskiy@lairdconnect.com>
 *
 * Licensed under GPLv2 or later.
 */

/dts-v1/;

/* SOM60 module definition */
#include "at91-som60.dtsi"

/* DVK MFG board definition */
#include "at91-dvk_su60_somc_mfg.dtsi"

/ {
	model = "Laird MFG SOM60";
	compatible = "laird,mfg-som60", "laird,som60", "atmel,sama5d36", "atmel,sama5d3", "atmel,sama5";
};
