// SPDX-License-Identifier: LicenseRef-Ezurio-Clause
/*
 * at91-dvk_som60_rdvk.dts - Device Tree file for the DVK SOM60 board
 *
 * Copyright (C) 2018 Ezurio
 */

/dts-v1/;

/* SOM60 module definition */
#include "at91-som60.dtsi"

/* DVK MFG board definition */
#include "at91-dvk_su60_somc_mfg.dtsi"

/ {
	model = "Summit MFG SOM60";
	compatible = "summit,mfg-som60", "summit,som60", "atmel,sama5d36", "atmel,sama5d3", "atmel,sama5";
};
