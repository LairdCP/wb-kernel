// SPDX-License-Identifier: GPL-2.0
/*
 * at91-dvk_som60_lwb_mfg.dts - Device Tree file for the som60 based LWB mfg platform
 *
 *  Copyright (C) 2020 Ezurio,
 *
 * Licensed under GPLv2 or later.
 */

/dts-v1/;

/* SOM60 module definition */
#include "at91-som60.dtsi"

/* DVK MFG board definition */
#include "at91-dvk_su60_somc_mfg.dtsi"

/* On-board 60 series radio disabled */
&mmc1 {
	status = "disabled";
};

/* 
 * LWB/LWB5/LWB5+ requires minimum 150ms after power-up until first access
 * Testing shows this isn't always sufficient
 */
&reg_mmc0_en {
	startup-delay-us = <250000>;
};

/ {
	model = "Summit LWB MFG";
	compatible = "summit,lwb-som60", "summit,som60", "atmel,sama5d36", "atmel,sama5d3", "atmel,sama5";
};
