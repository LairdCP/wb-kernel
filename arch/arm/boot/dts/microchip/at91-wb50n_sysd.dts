// SPDX-License-Identifier: LicenseRef-Ezurio-Clause
/*
 * at91-wb50n_sysd.dts - Device Tree file for WB50N SYSD Evaluation Board
 *
 * Copyright (C) 2018 Ezurio
 */

/dts-v1/;

#include "at91-wb50n_sysd.dtsi"
#include "at91-dvk_wb50n.dtsi"
