// SPDX-License-Identifier: LicenseRef-Ezurio-Clause
/*
 * at91-wb50n_rdvk.dts - Device Tree file for WB50N RDVK Board
 *
 * Copyright (C) 2018 Ezurio
 */

/dts-v1/;

#include "at91-wb50n.dtsi"
#include "at91-dvk_wb50n.dtsi"

&mmc0 {
	keep-power-in-suspend;
};

&i2c0 {
	status = "disabled";
};

&spi1 {
	status = "disabled";
};