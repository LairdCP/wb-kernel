/*
 * at91-ig60ll.dts - Device Tree file for IG60 LL, based on SOM60x2 module
 *
 *  Copyright (C) 2019 Ezurio,
 *		  2019 Vishal Verma <vishal.verma@ezurio.com>
 *
 * Licensed under GPLv2 or later.
 */

/dts-v1/;

#include "at91-som60.dtsi"
#include "at91-ig60.dtsi"

/ {
	model = "Sentrius IG60 LL";
	compatible = "sentrius,ig60ll", "summit,som60", "atmel,sama5d36", "atmel,sama5d3", "atmel,sama5";
};

&power_led_green {
	/delete-property/ linux,default-trigger;

	default-state = "on";
};

&dbgu {
	status = "okay";
};
