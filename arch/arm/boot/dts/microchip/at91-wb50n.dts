// SPDX-License-Identifier: LicenseRef-Ezurio-Clause
/*
 * at91-wb50n.dts - Device Tree file for WB50N Evaluation Board
 *
 * Copyright (C) 2018 Ezurio
 */

/dts-v1/;

#include "at91-wb50n.dtsi"
#include "at91-dvk_wb50n.dtsi"
