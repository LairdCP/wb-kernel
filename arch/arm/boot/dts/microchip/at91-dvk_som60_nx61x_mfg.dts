// SPDX-License-Identifier: GPL-2.0
/*
 * at91-dvk_som60_nx61x_mfg.dts - Device Tree file for the som60 based Sona NX61X mfg platform
 *
 *  Copyright (C) 2020 Ezurio,
 */

/dts-v1/;

/* SOM60 module definition */
#include "at91-som60.dtsi"

/* DVK MFG board definition */
#include "at91-dvk_su60_somc_mfg.dtsi"

/* On-board 60 series radio disabled */
&mmc1 {
	status = "disabled";
};

&reg_mmc0_en {
	startup-delay-us = <150000>;
};

/ {
	model = "Summit NX61X MFG";
	compatible = "summit,nx61x-som60", "summit,som60", "atmel,sama5d36", "atmel,sama5d3", "atmel,sama5";
};
