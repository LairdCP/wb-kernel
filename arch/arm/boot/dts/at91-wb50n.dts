// SPDX-License-Identifier: GPL-2.0
/*
 * at91-wb50n.dts - Device Tree file for WB50N Evaluation Board
 *
 *  Copyright (C) 2018-2020 Laird Connectivity
 *
 */

/dts-v1/;

#include "at91-wb50n.dtsi"
#include "at91-dvk_wb50n.dtsi"
