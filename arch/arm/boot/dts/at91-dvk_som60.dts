// SPDX-License-Identifier: GPL-2.0
/*
 * at91-dvk_som60.dts - Device Tree file for the DVK SOM60 board
 *
 *  Copyright (C) 2018 Laird,
 *		  2018 Ben Whitten <ben.whitten@lairdconnect.com>
 *		  2018 Boris Krasnovskiy <boris.krasnovskiy@lairdconnect.com>
 *
 * Licensed under GPLv2 or later.
 */

/dts-v1/;

/* SOM60 module definition */
#include "at91-som60.dtsi"

/* DVK board definition */
#include "at91-dvk_su60_somc.dtsi"

/* Display & touchscreen definition */
#include "at91-dvk_su60_somc_lcm.dtsi"

/ {
	model = "Laird DVK SOM60";
	compatible = "laird,dvk-som60", "laird,som60", "atmel,sama5d36", "atmel,sama5d3", "atmel,sama5";
};
