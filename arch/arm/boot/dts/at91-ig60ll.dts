/*
 * at91-ig60ll.dts - Device Tree file for Laird IG60 LL, based on SOM60x2 module
 *
 *  Copyright (C) 2019 Laird,
 *		  2019 Vishal Verma <vishal.verma@lairdconnect.com>
 *
 * Licensed under GPLv2 or later.
 */

/dts-v1/;

#include "at91-som60x2.dtsi"
#include "at91-ig60.dtsi"

/ {
	model = "Laird IG60 LL";
	compatible = "laird,ig60ll", "laird,som60x2", "atmel,sama5d36", "atmel,sama5d3", "atmel,sama5";

};

&power_led_green {
	/delete-property/ linux,default-trigger;
	default-state = "on";
};

&dbgu {
	status = "okay";
};
